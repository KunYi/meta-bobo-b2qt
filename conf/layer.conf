## conf/layer.conf
```bitbake
# We have a conf and classes directory, add to BBPATH
BBPATH .= ":${LAYERDIR}"

# We have recipes-* directories, add to BBFILES
BBFILES += "${LAYERDIR}/recipes-*/*/*.bb \
	${LAYERDIR}/recipes-*/*/*.bbappend"

BBFILE_COLLECTIONS += " imx6dlbobo9 imx6dlbobo12 "
BBFILE_PATTERN_imx6dlbobo9 = "^${LAYERDIR}/"
BBFILE_PATTERN_imx6dlbobo12 = "^${LAYERDIR}/"
BBFILE_PRIORITY_imx6dlbobo9 = "24"
BBFILE_PRIORITY_imx6dlbobo12 = "24"
```

## conf/machine/imx6dlbobo9.conf
```bitbake
#@TYPE: Machine
#@NAME: Bobo9/12 i.MX6DL board
#@SOC: i.MX6SOLO
#@DESCRIPTION: Machine configuration for Bobo 9/12 project
#@MAINTAINER: kunyi chen <kunnyi_chen@ubiqconn.com>

require conf/machine/include/imx6bobo-common.inc

SOC_FAMILY = "mx6:mx6dl:imx6q:imx6solo"

PREFERRED_PROVIDER_u-boot = "u-boot-imx"
PREFERRED_PROVIDER_virtual/bootloader = "u-boot-imx"
PREFERRED_PROVIDER_virtual/kernel = "linux-imx"

UBOOT_CONFIG ??= "sd"
UBOOT_CONFIG[sd] = "bobo9_config,sdcard"
UBOOT_CONFIG[mfgtool] = "bobo9_config"

ENABLED_SECURE_BOOT = "yes"
```

## conf/machine/include/imx6bobo-common.inc
```bitbake
# Provides the i.MX6 Tinto project common settings

require conf/machine/include/imx-base.inc
require conf/machine/include/tune-cortexa9.inc

SERIAL_CONSOLES = "115200;ttymxc2"
UBOOT_ENTRYPOINT_mx6  = "0x12000000"
KERNEL_DEVICETREE = "imx6dl-bobo9.dtb \
		     imx6dl-bobo12.dtb"

MACHINE_FEATURES += " wifi bluetooth"

IMAGE_INSTALL_append += " eeti"
CORE_IMAGE_EXTRA_INSTALL += " u-boot-fw-utils"

KERNEL_MODULE_AUTOLOAD ?= ""
```
